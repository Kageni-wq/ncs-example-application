## app/build/Kconfig/Kconfig.shield
```kconfig
osource "C:/Stethy18.00/boards/shields/*/Kconfig.shield"
osource "C:/ncs/v3.0.2/nrf/boards/shields/*/Kconfig.shield"
```

## app/build/Kconfig/Kconfig.shield.defconfig
```kconfig
osource "C:/Stethy18.00/boards/shields/*/Kconfig.defconfig"
osource "C:/ncs/v3.0.2/nrf/boards/shields/*/Kconfig.defconfig"
```

## app/build/Kconfig/boards/Kconfig.defconfig
```kconfig
# Load Zephyr board defconfig descriptions.
osource "C:/Stethy18.00/boards/kiko/puuwai/Kconfig.defconfig"
```

## app/build/app/Kconfig/boards/Kconfig
```kconfig
# Load Zephyr board Kconfig descriptions.
osource "C:/Stethy18.00/boards/kiko/puuwai/Kconfig"
```

## app/build/app/Kconfig/boards/Kconfig.puuwai
```kconfig
# Load board Kconfig descriptions.
osource "C:/Stethy18.00/boards/kiko/puuwai/Kconfig.puuwai"
```

## app/src/audio/Kconfig
```kconfig
#
# Copyright (c) 2022 Nordic Semiconductor ASA
#
# SPDX-License-Identifier: LicenseRef-Nordic-5-Clause
#

rsource "Kconfig.defaults"

menu "Audio"

#----------------------------------------------------------------------------#
menu "Log levels"

module = AUDIO_SYSTEM
module-str = audio-system
source "subsys/logging/Kconfig.template.log_config"

module = SW_CODEC_SELECT
module-str = sw-codec-select
source "subsys/logging/Kconfig.template.log_config"

module = STREAMCTRL
module-str = streamctrl
source "subsys/logging/Kconfig.template.log_config"

module = AUDIO_DATAPATH
module-str = audio-datapath
source "subsys/logging/Kconfig.template.log_config"

module = AUDIO_SYNC_TIMER
module-str = audio-sync-timer
source "subsys/logging/Kconfig.template.log_config"

module = LE_AUDIO_RX
module-str = le-audio-rx
source "subsys/logging/Kconfig.template.log_config"

module = BTM_AUDIO
module-str = btm-audio
source "subsys/logging/Kconfig.template.log_config"

module = DSP_AUDIO
module-str = dsp-audio
source "subsys/logging/Kconfig.template.log_config"

endmenu # Log levels

#----------------------------------------------------------------------------#
menu "Thread priorities"

config ENCODER_THREAD_PRIO
	int "Priority for encoder thread"
	default 3
	help
	  This is a preemptible thread.

config AUDIO_DATAPATH_THREAD_PRIO
	int "Priority for audio datapath thread"
	default 4
	help
	  This is a preemptible thread.

config BUTTON_MSG_SUB_THREAD_PRIO
	int "Thread priority for button subscriber"
	default 5
	help
	  This is a preemptible thread.
	  This thread will subscribe to button events from zbus.

config LE_AUDIO_MSG_SUB_THREAD_PRIO
	int "Thread priority for LE Audio subscriber"
	default 5
	help
	  This is a preemptible thread.
	  This thread will subscribe to LE Audio events from zbus.

config BT_MGMT_MSG_SUB_THREAD_PRIO
	int "Thread priority for bt_mgmt subscriber"
	default 5
	help
	  This is a preemptible thread.
	  This thread will subscribe to BT management events from zbus.

config CONTENT_CONTROL_MSG_SUB_THREAD_PRIO
	int "Thread priority for content control subscriber"
	default 5
	help
	  This is a preemptible thread.
	  This thread will subscribe to content control events from zbus.

config BTM_AUDIO_THREAD_PRIO
	int "Thread priority for BTM audio thread"
	default 5
	help
	  This is a preemptible thread.
	  This thread will handle control of BTM module.

config DSP_AUDIO_THREAD_PRIO
	int "Thread priority for DSP audio thread"
	default 5
	help
	  This is a preemptible thread.
	  This thread will handle control of DSP module.

endmenu # Thread priorities

#----------------------------------------------------------------------------#
menu "Stack sizes"

config BUTTON_MSG_SUB_STACK_SIZE
	int "Stack size for button subscriber"
	default 2048

config LE_AUDIO_MSG_SUB_STACK_SIZE
	int "Stack size for LE Audio subscriber"
	default 2048

config BT_MGMT_MSG_SUB_STACK_SIZE
	int "Stack size for bt_mgmt subscriber"
	default 2048

config CONTENT_CONTROL_MSG_SUB_STACK_SIZE
	int "Stack size for content control subscriber"
	default 1024

config BTM_AUDIO_STACK_SIZE
	int "Stack size for BTM audio thread"
	default 1024

config DSP_AUDIO_STACK_SIZE
	int "Stack size for DSP audio thread"
	default 1024

endmenu # Stack sizes

#----------------------------------------------------------------------------#
menu "Zbus"

config BUTTON_MSG_SUB_QUEUE_SIZE
	int "Queue size for button subscriber"
	default 4

config CONTENT_CONTROL_MSG_SUB_QUEUE_SIZE
	int "Queue size for content control subscriber"
	default 4

config AUDIO_MSG_SUB_QUEUE_SIZE
	int "Queue size for audio subscriber"
	default 4

endmenu # Zbus
endmenu # Audio
```

## app/src/drivers/at_master/Kconfig
```kconfig
menu "AT_Master"

config MAX_PARAMS_PER_EVENT
	int "Max number of parameters per event"
	default 3

config MAX_PARAM_LENGTH
	int "Max length of each parameter"
	default 64

config MAX_EVENT_LENGTH
	int "Max length of event name"
	default 64

config UART_RX_BUF_SIZE
	int "UART RX buffer size"
	default 64

config UART_RX_TIMEOUT_MS
	int "UART RX timeout in milliseconds"
	default 100

config ATM_AUDIO_LOG_LEVEL
	int "ATM Audio log level"
	default 3

endmenu # Serial
```

## app/src/led/Kconfig
```kconfig
menu "LED Configuration"

config SAMPLE_LED_UPDATE_DELAY
	int "Delay between LED updates in ms"
	default 50
	help
	  Delay between LED updates in ms.

config SAMPLE_LED_BRIGHTNESS
	int "LED brightness"
	default 16
	range 1 255
	help
	  Brightness level of each LED. Defaults to a low value to make
	  it easier to distinguish colors.

endmenu
```

## app/src/power/Kconfig
```kconfig
config ZSW_PMIC_BATTERY_CUTOFF_VOLTAGE_MV
	int "The voltage at which the system will be powered off. Running batteries as low as possible (until battery protection circuit triggers) will reduce the battery life."
	depends on DT_HAS_NORDIC_NPM1300_ENABLED
	default 3300
	help
	  Voltage in mV at which the system will be powered off.

config PMIC_STACK_SIZE
	int "Stack size for PMIC thread"
	default 1024

config PMIC_THREAD_PRIO
	int "Thread priority for PMIC thread"
	default 5
	help
	  This is a preemptible thread.
	  This thread will handle control of PMIC module.
```

## boards/kiko/puuwai/board.yml
```yaml
board:
  name: puuwai
  vendor: nordic
  socs:
  - name: 'nrf5340'
    variants:
    - name: 'ns'
      cpucluster: 'cpuapp'
  revision:
    format: number
    default: "1"
    exact: false
    revisions:
    - name: "1"
    - name: "2"
    - name: "3"
```

## drivers/display/ssd1357/Kconfig
```kconfig
config SSD1357  
	bool "Custom SSD1357 display driver"
	default y
	depends on DT_HAS_ZEPHYR_CUSTOM_SSD1357_ENABLED
	select SPI
	help
	  Enable custom SSD1357 driver
```

## drivers/display/ssd1357/Kconfig.ssd1357
```kconfig
# SSD1357 display controller configuration options
# Copyright (c) 2025 MASSDRIVER EI (massdriver.space)
# SPDX-License-Identifier: Apache-2.0

menuconfig SSD1357
	bool "SSD1357 display controller driver"
	default y
	depends on DT_HAS_SOLOMON_SSD1357_ENABLED
	select MIPI_DBI
	help
	  Enable driver for SSD1357 display controller.

if SSD1357

config SSD1357_DEFAULT_CONTRAST
	int "SSD1357 default contrast"
	default 100
	range 0 255
	help
	  SSD1357 default contrast.

config SSD1357_CONTRASTA
	int "SSD1357 contrast multiplier for seg A"
	default 145
	range 0 255
	help
	  Contrast multiplier for seg A

config SSD1357_CONTRASTB
	int "SSD1357 contrast multiplier for seg B"
	default 80
	range 0 255
	help
	  Contrast multiplier for seg B

config SSD1357_CONTRASTC
	int "SSD1357 contrast multiplier for seg C"
	default 125
	range 0 255
	help
	  Contrast multiplier for seg C

endif # SSD1357
```
